## firmware/sdkconfig.defaults
```kconfig
# WiFi configuration (Station + SoftAP)
CONFIG_ESP_WIFI_SOFTAP_SUPPORT=y
CONFIG_ESP_WIFI_NAN_ENABLE=n
CONFIG_ESP_WIFI_STA_DISCONNECTED_PM_ENABLE=n

# Custom partition table
CONFIG_PARTITION_TABLE_CUSTOM=y
CONFIG_PARTITION_TABLE_CUSTOM_FILENAME="/Users/shreyashgupta/Documents/Github/days-to-thing-tracker/firmware/partitions.csv"

# Flash size (XIAO ESP32-C6 has 4MB)
CONFIG_ESPTOOLPY_FLASHSIZE_4MB=y

# Main task stack size (16KB for display rendering)
CONFIG_ESP_MAIN_TASK_STACK_SIZE=16384

# HTTP server config
CONFIG_HTTPD_MAX_REQ_HDR_LEN=1024
CONFIG_HTTPD_MAX_URI_LEN=512

# Logging
CONFIG_LOG_DEFAULT_LEVEL_INFO=y

# LittleFS support
CONFIG_LITTLEFS_MAX_PARTITIONS=3

# SPI RAM (not available on C6, but ensure config is clean)
CONFIG_SPIRAM=n

# Disable unused features to save flash
CONFIG_BT_ENABLED=n
CONFIG_MBEDTLS_CERTIFICATE_BUNDLE=n
```
